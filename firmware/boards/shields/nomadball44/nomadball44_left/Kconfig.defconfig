## firmware/boards/shields/nomadball44/nomadball44_left/Kconfig.defconfig
```kconfig
if SHIELD_NOMADBALL44_LEFT

config ZMK_KEYBOARD_NAME
	default "NomadBall44 Left"

config ZMK_SPLIT
	default y

endif
```

## firmware/boards/shields/nomadball44/nomadball44_left/Kconfig.shield
```kconfig
config SHIELD_NOMADBALL44_LEFT
	def_bool $(shields_list_contains,nomadball44_left)
```

## firmware/boards/shields/nomadball44/nomadball44_right/Kconfig.defconfig
```kconfig
if SHIELD_NOMADBALL44_RIGHT

config ZMK_KEYBOARD_NAME
	default "NomadBall44 Right"

config ZMK_SPLIT
	default y

config ZMK_SPLIT_ROLE_CENTRAL
	default y

config EC11
	default y

config EC11_TRIGGER_GLOBAL_THREAD
	default y

config SPI
	default y

config INPUT
	default y

config ZMK_POINTING
	default y

config PMW3610_ALT
	default y

endif
```

## firmware/boards/shields/nomadball44/nomadball44_right/Kconfig.shield
```kconfig
config SHIELD_NOMADBALL44_RIGHT
	def_bool $(shields_list_contains,nomadball44_right)
```
